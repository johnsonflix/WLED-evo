#include "wled.h"

#if defined(ARDUINO_ARCH_ESP32)

// wled.h provides ArduinoJson + WiFi + Update transitively. The *_evolights
// envs override the platform to stock PlatformIO espressif32 (see
// EVOLIGHTS-ANCHOR: platform-stock-espressif32 in platformio.ini), which
// retains the full mbedtls SSL stack and WiFiClientSecure — so we can
// download the firmware artifact over HTTPS.
#include "ota_verifier.h"
#include <HTTPClient.h>
#include <Update.h>
#include <WiFiClientSecure.h>
#include <mbedtls/base64.h>
#include <mbedtls/sha256.h>

// Ed25519 verify is provided by mbedTLS in ESP-IDF v5+; older variants ship
// the older API. Both compile against esp_random + mbedtls; if the toolchain
// lacks Ed25519, build will fail clearly with a missing symbol.
extern "C" {
  #include <mbedtls/pk.h>
}

namespace EvoLights::OTA {

// EVOLIGHTS-ANCHOR: ota-pubkey
// Ed25519 public key, base64-encoded raw 32 bytes. Generated by
// evolights-cloud/tools/generate-ota-keys.sh. Replace before production builds.
// The matching private key signs every firmware manifest the cloud serves.
static const char OTA_PUBKEY_B64[] PROGMEM =
  "q9G3Y5Dw2BYnhVdX2/DFsAF9xH52Jabf2i7tu2UKANI=";
// EVOLIGHTS-ANCHOR: ota-pubkey-end

// Definition for the externally-visible marker declared in ota_verifier.h.
// Points at the same PROGMEM bytes as OTA_PUBKEY_B64 so the verifier script
// has a stable C symbol to grep for if it ever wants to reach across the
// module from outside the anonymous namespace below.
const char* const OTA_PUBKEY_B64_MARKER = OTA_PUBKEY_B64;

namespace {

  bool b64decode(const char *in, uint8_t *out, size_t outCap, size_t *outLen) {
    return mbedtls_base64_decode(out, outCap, outLen,
      (const unsigned char*)in, strlen(in)) == 0;
  }

  bool hex2bytes(const char *hex, uint8_t *out, size_t outLen) {
    if (strlen(hex) != outLen * 2) return false;
    for (size_t i = 0; i < outLen; i++) {
      char hi = hex[i*2], lo = hex[i*2+1];
      auto v = [](char c) -> int {
        if (c >= '0' && c <= '9') return c - '0';
        if (c >= 'a' && c <= 'f') return c - 'a' + 10;
        if (c >= 'A' && c <= 'F') return c - 'A' + 10;
        return -1;
      };
      int h = v(hi), l = v(lo);
      if (h < 0 || l < 0) return false;
      out[i] = (h << 4) | l;
    }
    return true;
  }

  // Build a one-shot mbedtls public-key object from the embedded raw 32 bytes.
  // We wrap them in the SubjectPublicKeyInfo DER prelude so mbedtls_pk_parse_public_key
  // accepts it: 30 2a 30 05 06 03 2b 65 70 03 21 00 <pubkey>
  bool buildPublicKey(mbedtls_pk_context &ctx) {
    uint8_t raw[32]; size_t rawLen = 0;
    char b64Copy[64]; strncpy(b64Copy, OTA_PUBKEY_B64, sizeof(b64Copy)-1); b64Copy[sizeof(b64Copy)-1] = 0;
    if (!b64decode(b64Copy, raw, sizeof(raw), &rawLen) || rawLen != 32) return false;

    static const uint8_t spkiPrefix[] = {
      0x30, 0x2a, 0x30, 0x05, 0x06, 0x03, 0x2b, 0x65, 0x70, 0x03, 0x21, 0x00
    };
    uint8_t spki[sizeof(spkiPrefix) + 32];
    memcpy(spki, spkiPrefix, sizeof(spkiPrefix));
    memcpy(spki + sizeof(spkiPrefix), raw, 32);

    mbedtls_pk_init(&ctx);
    return mbedtls_pk_parse_public_key(&ctx, spki, sizeof(spki)) == 0;
  }

  bool verifySignature(const String &version, const String &url, const String &sha256Hex,
                       const String &sigB64) {
    mbedtls_pk_context pk;
    if (!buildPublicKey(pk)) return false;

    uint8_t sig[64]; size_t sigLen = 0;
    char sigCopy[128]; strncpy(sigCopy, sigB64.c_str(), sizeof(sigCopy)-1); sigCopy[sizeof(sigCopy)-1] = 0;
    if (!b64decode(sigCopy, sig, sizeof(sig), &sigLen) || sigLen != 64) {
      mbedtls_pk_free(&pk); return false;
    }

    String msg = version + "|" + url + "|" + sha256Hex;
    int rc = mbedtls_pk_verify(&pk, MBEDTLS_MD_NONE,
                               (const unsigned char*)msg.c_str(), msg.length(),
                               sig, sigLen);
    mbedtls_pk_free(&pk);
    if (rc != 0) {
      Serial.printf("[OTA] sig verify failed rc=-0x%04x\n", -rc);
      return false;
    }
    return true;
  }

} // anonymous namespace

bool processManifest(const char *json, size_t len) {
  StaticJsonDocument<1024> doc;
  if (deserializeJson(doc, json, len)) { Serial.println(F("[OTA] bad manifest JSON")); return false; }
  String version = doc["version"] | "";
  String url     = doc["url"]     | "";
  String sigB64  = doc["sig"]     | "";
  String sha256  = doc["sha256"]  | "";
  if (!version.length() || !url.length() || !sigB64.length() || sha256.length() != 64) {
    Serial.println(F("[OTA] manifest missing fields")); return false;
  }
  // EVOLIGHTS-ANCHOR: ota-downgrade-protection
  // Downgrade protection. WLED's VERSION macro is a yymmddb-style integer
  // (e.g. 2605011 for 2026-05-01 build #1). Reject anything that's not
  // STRICTLY GREATER than what we're already running. Without this, a signed
  // manifest for an OLDER build could be replayed against newer devices —
  // turning OTA into a downgrade attack vector for any vulnerability fixed
  // since the older build.
  unsigned long manifestVer = strtoul(version.c_str(), nullptr, 10);
  unsigned long currentVer  = (unsigned long)VERSION;
  if (manifestVer == 0) {
    Serial.printf("[OTA] manifest version '%s' not a yymmddb integer; refusing\n", version.c_str());
    return false;
  }
  if (manifestVer <= currentVer) {
    Serial.printf("[OTA] manifest %lu <= current %lu; refusing (downgrade)\n", manifestVer, currentVer);
    return false;
  }
  // EVOLIGHTS-ANCHOR: ota-downgrade-protection-end

  if (!verifySignature(version, url, sha256, sigB64)) return false;

  Serial.printf("[OTA] sig OK; downloading %s\n", url.c_str());

  // EVOLIGHTS-ANCHOR: ota-trust-model
  // Trust model: the Ed25519 signature on `version|url|sha256` (verified
  // above against the OTA_PUBKEY_B64 compiled into firmware) is the
  // canonical trust anchor for what we flash. We additionally use TLS for
  // the artifact download to deny passive observers visibility into which
  // device is fetching which build, and to deny on-path attackers the
  // ability to silently swap the bytes for a different signed payload (which
  // would still fail sha256 and signature checks — but failing earlier is
  // strictly better).
  //
  // The artifact is served from a CDN whose CA is not the same as the MQTT
  // broker CA (which lives in cloud_relay state), so we use setInsecure()
  // here: the Ed25519 signature on `version|url|sha256` plus the sha256
  // verify on the downloaded bytes is the actual trust chain. A MITM can:
  //   - drop/corrupt the bytes        -> sha256 mismatch -> Update.abort()
  //   - feed a previously-signed bin  -> downgrade check above OR sha256 mismatch
  //   - inject malware                -> signature wouldn't verify; we never reach here
  // Even with setInsecure() the transport is still encrypted on the wire.
  WiFiClientSecure client;
  client.setInsecure();
  HTTPClient http;
  if (!http.begin(client, url)) { Serial.println(F("[OTA] http.begin failed")); return false; }
  // EVOLIGHTS-ANCHOR: ota-trust-model-end
  int code = http.GET();
  if (code != 200) {
    Serial.printf("[OTA] download failed %d\n", code);
    http.end(); return false;
  }
  size_t total = http.getSize();
  if (total == 0) { Serial.println(F("[OTA] zero-size firmware")); http.end(); return false; }

  if (!Update.begin(total)) {
    Serial.printf("[OTA] Update.begin failed: %s\n", Update.errorString());
    http.end(); return false;
  }

  WiFiClient *stream = http.getStreamPtr();
  mbedtls_sha256_context shaCtx;
  mbedtls_sha256_init(&shaCtx);
  mbedtls_sha256_starts(&shaCtx, 0);

  uint8_t buf[2048];
  size_t written = 0;
  uint32_t lastReport = millis();
  while (http.connected() && written < total) {
    size_t avail = stream->available();
    if (!avail) { delay(5); continue; }
    size_t toRead = avail < sizeof(buf) ? avail : sizeof(buf);
    int got = stream->readBytes(buf, toRead);
    if (got <= 0) continue;
    if (Update.write(buf, got) != (size_t)got) {
      Serial.printf("[OTA] flash write failed: %s\n", Update.errorString());
      mbedtls_sha256_free(&shaCtx);
      http.end(); return false;
    }
    mbedtls_sha256_update(&shaCtx, buf, got);
    written += got;
    if (millis() - lastReport > 1000) {
      Serial.printf("[OTA] %u/%u bytes\n", (unsigned)written, (unsigned)total);
      lastReport = millis();
    }
  }
  http.end();

  uint8_t hash[32]; mbedtls_sha256_finish(&shaCtx, hash); mbedtls_sha256_free(&shaCtx);
  uint8_t expected[32];
  if (!hex2bytes(sha256.c_str(), expected, 32) || memcmp(hash, expected, 32) != 0) {
    Serial.println(F("[OTA] sha256 mismatch! aborting flash"));
    Update.abort(); return false;
  }

  if (!Update.end(true)) {
    Serial.printf("[OTA] Update.end failed: %s\n", Update.errorString());
    return false;
  }

  Serial.println(F("[OTA] flash complete; rebooting"));
  delay(500);
  ESP.restart();
  return true; // unreachable
}

} // namespace EvoLights::OTA

#endif // ARDUINO_ARCH_ESP32
